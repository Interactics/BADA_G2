#define MEGA

#include <ros.h>
#include <ros/time.h>

#include <Adafruit_FXAS21002C.h>
#include <Adafruit_FXOS8700.h>
#include <Adafruit_Sensor.h>
#include <Adafruit_GFX.h>
#include <Adafruit_NeoMatrix.h>
#include <Adafruit_NeoPixel.h>

#include <Wire.h>

#include <DynamixelMotor.h>

#include <sensor_msgs/Imu.h>
#include <sensor_msgs/MagneticField.h>

#include <std_msgs/Int16.h>
#include <std_msgs/Bool.h>

#define bounceTimer 200                           // For button
#define BUTTON 2                                  // For button

#define D_ID 1                                    //Dynmixel ID

ros::NodeHandle nh;

/*-------------------------- IMU --------------------------*/
Adafruit_FXAS21002C gyro   = Adafruit_FXAS21002C(0x0021002C);
Adafruit_FXOS8700 accelmag = Adafruit_FXOS8700(0x8700A, 0x8700B);

sensor_msgs::Imu imu_msg;
sensor_msgs::MagneticField mag_msg;
std_msgs::Header header;

ros::Publisher raw_imu("imu_bada_base", &imu_msg);
ros::Publisher raw_mag("mag_bada_base", &mag_msg);

sensors_event_t aevent, mevent, event;

unsigned long currentTime = millis(); // or millis()
unsigned long previousTime_IMU = currentTime;
unsigned long previousTime_BT  = currentTime;
unsigned long previousTime_DISPLAY = currentTime;

long imuTimeInterval = 50;

/*------------------------------------------------------------*/
/*-------------------------- END OF IMU -------------- -------*/


/*-------------------------- BUTTON --------------------------*/
std_msgs::Int16 ButtonState_msg;  // None - 0, N - 1, E - 2, W - 3, S - 4

ros::Publisher pub_button("sensor/button", &ButtonState_msg);

const uint8_t N_button_pin = 12;
const uint8_t E_button_pin = 11;
const uint8_t W_button_pin = 10;
const uint8_t S_button_pin =  9;

bool last_reading;
long last_debounce_time = 0;
long debounce_delay     = 50;
bool published           = true;

bool button_pressed = false;

/*------------------------------------------------------------*/
/*-------------------------- END_OF_BUTTON--------------------*/






/*--------------------------Dynamixel-------------------------*/
int16_t                speed        = 125;         // speed, between 0 and 1023
const long unsigned int DX_baudrate = 1000000;     // communication baudrate

HardwareDynamixelInterface interface(Serial3);// Serial1 -- RX2 TX2, Serial -- RX1 TX1
DynamixelMotor motor(interface, D_ID);

bool DXup = false;
void DXcmdCB(const std_msgs::Bool& cmd);   //DX callback
ros::Subscriber<std_msgs::Bool> Sub_cmdDX("sensor/DXup", &DXcmdCB);

/*--------------------------------------------------------------*/
/*--------------------------END_OF_Dynamixel--------------------*/



/*------------------------Display-----------------------------*/
#define PIN 6
#define mw 16 // Define matrix width and height.
#define mh 16
#define BRIGHTNESS 30

#define LED_BLACK 0

#define LED_RED_VERYLOW (3 << 11)
#define LED_RED_LOW (7 << 11)
#define LED_RED_MEDIUM (15 << 11)
#define LED_RED_HIGH (31 << 11)

#define LED_GREEN_VERYLOW (1 << 5)
#define LED_GREEN_LOW (15 << 5)
#define LED_GREEN_MEDIUM (31 << 5)
#define LED_GREEN_HIGH (63 << 5)

#define LED_BLUE_VERYLOW 3
#define LED_BLUE_LOW 7
#define LED_BLUE_MEDIUM 15
#define LED_BLUE_HIGH 31

#define LED_ORANGE_VERYLOW (LED_RED_VERYLOW + LED_GREEN_VERYLOW)
#define LED_ORANGE_LOW (LED_RED_LOW + LED_GREEN_LOW)
#define LED_ORANGE_MEDIUM (LED_RED_MEDIUM + LED_GREEN_MEDIUM)
#define LED_ORANGE_HIGH (LED_RED_HIGH + LED_GREEN_HIGH)

#define LED_PURPLE_VERYLOW (LED_RED_VERYLOW + LED_BLUE_VERYLOW)
#define LED_PURPLE_LOW (LED_RED_LOW + LED_BLUE_LOW)
#define LED_PURPLE_MEDIUM (LED_RED_MEDIUM + LED_BLUE_MEDIUM)
#define LED_PURPLE_HIGH (LED_RED_HIGH + LED_BLUE_HIGH)

#define LED_CYAN_VERYLOW (LED_GREEN_VERYLOW + LED_BLUE_VERYLOW)
#define LED_CYAN_LOW (LED_GREEN_LOW + LED_BLUE_LOW)
#define LED_CYAN_MEDIUM (LED_GREEN_MEDIUM + LED_BLUE_MEDIUM)
#define LED_CYAN_HIGH (LED_GREEN_HIGH + LED_BLUE_HIGH)

#define LED_WHITE_VERYLOW (LED_RED_VERYLOW + LED_GREEN_VERYLOW + LED_BLUE_VERYLOW)
#define LED_WHITE_LOW (LED_RED_LOW + LED_GREEN_LOW + LED_BLUE_LOW)
#define LED_WHITE_MEDIUM (LED_RED_MEDIUM + LED_GREEN_MEDIUM + LED_BLUE_MEDIUM)
#define LED_WHITE_HIGH (LED_RED_HIGH + LED_GREEN_HIGH + LED_BLUE_HIGH)

std_msgs::Int16 displayImg;

int display_cmd;


void displayCB(const std_msgs::Int16& display_msg) {
  display_cmd = display_msg.data;
}
ros::Subscriber<std_msgs::Int16> sub_display("sensor/Display", &displayCB);


static const uint16_t PROGMEM RGB_bmp[][16 * 16] = {
  { //bada 0
    0x0000, 0x0000, 0x0000, 0x0000, 0x0000, 0x0f00, 0x0f00, 0x0f00, 0x0f00, 0x0f00, 0x0f00, 0x0000, 0x0000, 0x0000, 0x0000, 0x0000,
    0x0000, 0x0000, 0x0000, 0x0f00, 0x0f00, 0xffff, 0xffff, 0xffff, 0xffff, 0xffff, 0xffff, 0x0f00, 0x0f00, 0x0000, 0x0000, 0x0000,
    0x0000, 0x0000, 0x0f00, 0x0f00, 0xffff, 0xffff, 0xffff, 0xffff, 0xffff, 0xffff, 0xffff, 0xffff, 0x0f00, 0x0f00, 0x0000, 0x0000,
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    0x0000, 0x0000, 0x0000, 0x0000, 0x0000, 0x0f00, 0x0f00, 0x0f00, 0x0f00, 0x0f00, 0x0f00, 0x0000, 0x0000, 0x0000, 0x0000, 0x0000
  },
  { // bell 1 0x0F0 GREEN, 0x00FF YELLOW
    0x0000, 0x0000, 0x0000, 0x0000, 0x0000, 0x0000, 0x0000, 0x0000, 0x0000, 0x0000, 0x0000, 0x0000, 0x0000, 0x0000, 0x0000, 0x0000,
    0x0000, 0x0000, 0x0000, 0x0000, 0x0000, 0x0000, 0x0000, 0x0000, 0x0000, 0x0000, 0x0000, 0x0000, 0x0000, 0x0000, 0x0000, 0x0000,
    0x0000, 0x0000, 0x0000, 0x0000, 0x0000, 0x0000, 0x0000, 0x00FF, 0x00FF, 0x0000, 0x0000, 0x0000, 0x0000, 0x0000, 0x0000, 0x0000,
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    0x0000, 0x0000, 0x0000, 0x0000, 0x0000, 0x0000, 0x0000, 0x0000, 0x0000, 0x0000, 0x0000, 0x0000, 0x0000, 0x0000, 0x0000, 0x0000
  },

  // fire 2
  { 0x0000, 0x0000, 0x0000, 0x0000, 0x0000, 0x0000, 0x0000, 0x000F, 0x0000, 0x0000, 0x0000, 0x0000, 0x0000, 0x0000, 0x0000, 0x0000,
    0x0000, 0x0000, 0x0000, 0x0000, 0x0000, 0x0000, 0x000F, 0x000F, 0x0000, 0x0000, 0x0000, 0x0000, 0x0000, 0x0000, 0x0000, 0x0000,
    0x0000, 0x0000, 0x0000, 0x0000, 0x0000, 0x000F, 0x000F, 0x000F, 0x0000, 0x0000, 0x0000, 0x0000, 0x0000, 0x0000, 0x0000, 0x0000,
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    0x0000, 0x0000, 0x0000, 0x000F, 0x00FF, 0x00FF, 0x00FF, 0x00FF, 0x00FF, 0x00FF, 0x00FF, 0x00FF, 0x000F, 0x0000, 0x0000, 0x0000
  },

  // baby 3
  { 0x0000, 0x0000, 0x0000, 0x0000, 0x0000, 0x0000, 0x0000, 0x0000, 0x0000, 0x0000, 0x0000, 0x0000, 0x0000, 0xffff, 0xffff, 0x0000,
    0x0000, 0x0000, 0x0000, 0x0000, 0x0000, 0x0000, 0x0000, 0x0000, 0x0000, 0xffff, 0xffff, 0x0000, 0xffff, 0xffff, 0xffff, 0xffff,
    0x0000, 0x0000, 0x0000, 0x0000, 0x0000, 0x0000, 0x0000, 0x0000, 0xffff, 0xffff, 0x0555, 0xffff, 0xffff, 0x0555, 0xffff, 0xffff,
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    0x0000, 0x0000, 0x0000, 0x0000, 0xffff, 0xffff, 0xffff, 0x0000, 0x0000, 0x0000, 0x0000, 0x0000, 0x0000, 0x0000, 0x0000, 0x0000
  },

  { //DOOR 4
    0x0000, 0x0000, 0x0000, 0x0000, 0x0000, 0x0000, 0x0000, 0x0000, 0x0000, 0x0000, 0x0000, 0x0000, 0x0000, 0x0000, 0x0000, 0x0000,
    0x0000, 0x0000, 0x0000, 0x0000, 0x0000, 0x0000, 0x0000, 0x0000, 0x0000, 0x0000, 0x0000, 0x0000, 0x0000, 0x0000, 0x0000, 0x0000,
    0x0000, 0x0000, 0x0000, 0xffff, 0xffff, 0xffff, 0xffff, 0xffff, 0xffff, 0xffff, 0xffff, 0xffff, 0xffff, 0x0000, 0x0000, 0x0000,
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    0x0000, 0xffff, 0xffff, 0xffff, 0xffff, 0xffff, 0xffff, 0xffff, 0xffff, 0xffff, 0xffff, 0xffff, 0xffff, 0xffff, 0xffff, 0x0000
  },

  { //water 5
    0x0000, 0x0000, 0x0000, 0x0000, 0x0000, 0x0000, 0x0000, 0x0f00, 0x0f00, 0x0000, 0x0000, 0x0000, 0x0000, 0x0000, 0x0000, 0x0000,
    0x0000, 0x0000, 0x0000, 0x0000, 0x0000, 0x0000, 0x0000, 0x0f00, 0x0f00, 0x0000, 0x0000, 0x0000, 0x0000, 0x0000, 0x0000, 0x0000,
    0x0000, 0x0000, 0x0000, 0x0000, 0x0000, 0x0000, 0x0f00, 0x0000, 0x0000, 0x0f00, 0x0000, 0x0000, 0x0000, 0x0000, 0x0000, 0x0000,
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    0x0000, 0x0000, 0x0000, 0x0000, 0x0000, 0x0000, 0x0f00, 0x0f00, 0x0f00, 0x0f00, 0x0000, 0x0000, 0x0000, 0x0000, 0x0000, 0x0000
  },
};



Adafruit_NeoMatrix *matrix = new Adafruit_NeoMatrix(
  mw, mh, PIN,
  NEO_MATRIX_TOP + NEO_MATRIX_LEFT + NEO_MATRIX_ROWS + NEO_MATRIX_ZIGZAG,
  NEO_GRB + NEO_KHZ800);

/*--------------------------------------------------------------*/
///////////////////////////////////////////////////////////////////


void setup() {
  ROSInit();
  IMUInit();
  DXInit();
  ButtonInit();
  displayInit();

}

void loop() {
  IMUcmdLoop();
  DXcmdLoop();
  ButtoncmdLoop();
  DisplaycmdLoop();
}

void ROSInit() {
  nh.initNode();
  nh.advertise(raw_imu);
  nh.advertise(raw_mag);
  nh.advertise(pub_button);
  nh.subscribe(Sub_cmdDX);
  nh.subscribe(sub_display);

}

void DXInit() {
  interface.begin(DX_baudrate);
  delay(200);
  uint8_t status = motor.init();
  while (status != DYN_STATUS_OK) { //Failure check
    pinMode(LED_BUILTIN, OUTPUT);
    digitalWrite(LED_BUILTIN, HIGH);
    nh.loginfo("Dynamixel is not conected ");
    delay(1000);
  }
  motor.enableTorque();  // joint mode 180° angle range
  motor.jointMode(204, 820);
  motor.speed(speed);

  /// Init Movement
  motor.goalPosition(512);
  delay(1000);
  motor.goalPosition(350);
  /// Init Movement ///
}

void DXcmdCB (const std_msgs::Bool& cmd) {
  DXup = cmd.data;
}

void DXCtrl(bool cmd) {
  if (cmd) motor.goalPosition(350); // Changed!
  else  motor.goalPosition(500);    // Defalut
}

void DXcmdLoop() {
  if (DXup == true) DXCtrl(DXup);
  else DXCtrl(DXup);
}

void IMUcmdLoop() {
  currentTime = millis();
  if (currentTime - previousTime_IMU > imuTimeInterval) {
    pubIMU();
    previousTime_IMU = currentTime;
  }
}

void IMUInit() {
  if (!accelmag.begin(ACCEL_RANGE_4G)) {
    /* There was a problem detecting the FXOS8700 ... check your connections */
  }
  /* Initialise the sensor */
  if (!gyro.begin()) {
    /* There was a problem detecting the FXAS21002C ... check your connections
    */
  }
  // put your setup code here, to run once:
  gyro.begin();
  accelmag.begin(ACCEL_RANGE_4G);
}

void pubIMU() {
  ros::Time current_time =  nh.now();

  accelmag.getEvent(&aevent, &mevent);
  gyro.getEvent(&event);

  imu_msg.header.stamp       = current_time;
  imu_msg.header.frame_id    = "bada/imu";

  imu_msg.angular_velocity.x = event.gyro.x;
  imu_msg.angular_velocity.y = event.gyro.y;
  imu_msg.angular_velocity.z = event.gyro.z;

  imu_msg.linear_acceleration.x = aevent.acceleration.x;
  imu_msg.linear_acceleration.y = aevent.acceleration.y;
  imu_msg.linear_acceleration.z = aevent.acceleration.z;

  raw_imu.publish(&imu_msg);

  mag_msg.header.stamp = current_time;
  mag_msg.magnetic_field.x = mevent.magnetic.x;
  mag_msg.magnetic_field.y = mevent.magnetic.y;
  mag_msg.magnetic_field.z = mevent.magnetic.z;
  raw_mag.publish(&mag_msg);
  nh.spinOnce();
  ///  delay(50);
}

void ButtonInit() {
  ButtonState_msg.data = 0;

  pinMode(N_button_pin, INPUT_PULLUP);
  pinMode(E_button_pin, INPUT_PULLUP);
  pinMode(W_button_pin, INPUT_PULLUP);
  pinMode(S_button_pin, INPUT_PULLUP);
}

void pubButtonClk() {


  if (digitalRead(N_button_pin) == LOW) {
    ButtonState_msg.data = 1;
    pub_button.publish(&ButtonState_msg);
  }  // Pressed

  else if (digitalRead(E_button_pin) == LOW) {
    ButtonState_msg.data = 2;
    pub_button.publish(&ButtonState_msg);
  }

  else if (digitalRead(W_button_pin) == LOW) {
    ButtonState_msg.data = 3;
    pub_button.publish(&ButtonState_msg);
  }

  else if (digitalRead(S_button_pin) == LOW) {
    ButtonState_msg.data = 4;
    pub_button.publish(&ButtonState_msg);
  }
  else {
    ButtonState_msg.data = 0;
    pub_button.publish(&ButtonState_msg);
    digitalWrite(13, HIGH);
  }

}


void ButtoncmdLoop() {
  currentTime = millis();
  if (currentTime - previousTime_BT > 100) {
    pubButtonClk();
    previousTime_BT = currentTime;
  }
}

void fixdrawRGBBitmap(int16_t x, int16_t y, const uint16_t *bitmap, int16_t w, int16_t h) {
  uint16_t RGB_bmp_fixed[w * h];
  for (uint16_t pixel = 0; pixel < w * h; pixel++) {
    uint8_t r, g, b;
    uint16_t color = pgm_read_word(bitmap + pixel);

    //Serial.print(color, HEX);
    b = (color & 0xF00) >> 8;
    g = (color & 0x0F0) >> 4;
    r = color & 0x00F;
    b = map(b, 0, 15, 0, 31);
    g = map(g, 0, 15, 0, 63);
    r = map(r, 0, 15, 0, 31);
    RGB_bmp_fixed[pixel] = (r << 11) + (g << 5) + b;

  }
  matrix->drawRGBBitmap(x, y, RGB_bmp_fixed, w, h);
}

void display_rgbBitmap(uint8_t bmp_num) {
  static uint16_t bmx, bmy;

  fixdrawRGBBitmap(bmx, bmy, RGB_bmp[bmp_num], 16, 16);
  matrix->show();
}

void displayInit() {
  matrix->begin();
  matrix->setTextWrap(false);
  matrix->setBrightness(BRIGHTNESS);
  delay(500);
  matrix->clear();
  delay(500);
}

void displayClean() {
  matrix->clear();
  matrix->show();
}

void DisplaycmdLoop() {
  currentTime = millis();
  if (currentTime - previousTime_DISPLAY > 200) {
    display_rgbBitmap(display_cmd);
    previousTime_DISPLAY = currentTime;
    nh.spinOnce();

  }
}
